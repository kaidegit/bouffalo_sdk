## examples/solution/solution_bl616/image_transmission/defconfig
```kconfig
CONFIG_GCC_OPTIMISE_LEVEL =-O2

ifneq (,$(filter $(CHIP),bl616 bl616cl))
    CONFIG_WL80211 =y
    CONFIG_WL80211_WRAM_MEM_SIZE_LIMIT = 0x4000 # 16KB
endif

CONFIG_BFLB_LOG      =n
CONFIG_FREERTOS      =y
CONFIG_POSIX         =y
CONFIG_TLSF          =y
#CONFIG_SHELL        =y
CONFIG_LOG_DISABLE   =y
CONFIG_LWIP          =y
CONFIG_RF            =y
CONFIG_DHCPD         =y
CONFIG_MBEDTLS       =y

ifeq ($(CHIP),bl602)
    CONFIG_WIFI4=y
else
    CONFIG_WIFI6=y
    CONFIG_MACSW_SELECT = default
    ifeq ($(CONFIG_WL80211),y)
        CONFIG_BL_WPA_SUPPLICANT =y
    else
        CONFIG_FHOST=y
    endif
endif

CONFIG_VSNPRINTF_FLOAT      =y
CONFIG_VSNPRINTF_FLOAT_EX   =y
CONFIG_VSNPRINTF_LONG_LONG  =y

CONFIG_PSRAM =y

################### solution_utils config ###################
################### queue ###################
CONFIG_SOLUTION_QUEUE_YUYV          =y
CONFIG_SOLUTION_QUEUE_MJPEG         =y
CONFIG_SOLUTION_QUEUE_AUDIO_IN      =y
CONFIG_SOLUTION_QUEUE_AUDIO_OUT     =y

################### video ##################
## video default size
CONFIG_SOLUTION_VIDEO_DEFAULT_WIDTH  =240
CONFIG_SOLUTION_VIDEO_DEFAULT_HIGHT  =320
## dbi display (yuyv >> dbi_displa)
CONFIG_SOLUTION_FUNC_DBI_DISP       =y
## jpeg compression (yuyv >> jpeg)
CONFIG_SOLUTION_FUNC_MJPEG          =y
## dvp sensor (dvp >> yuyv)
CONFIG_SOLUTION_FUNC_DVP            =y

## image_transmission (jpeg)
CONFIG_SOLUTION_FUNC_HIBOOSTER_NEW  =y
CONFIG_HB_SEND_TEST                 =n
CONFIG_HB_RECV_TEST                 =y

## The default configuration of the solution_utils
-include $(BL_SDK_BASE)/examples/solution/solution_bl616/solution_utils/defconfig
# ################### solution_utils config end ###################

# Config
## mbedtls
CONFIG_MBEDTLS_AES_USE_HW =y
CONFIG_MBEDTLS_BIGNUM_USE_HW =y
CONFIG_MBEDTLS_ECC_USE_HW =y
CONFIG_MBEDTLS_SHA1_USE_HW =y
CONFIG_MBEDTLS_SHA256_USE_HW =y
CONFIG_MBEDTLS_SHA512_USE_HW =y

# 84KB WRAM for BL616/BL616CL, which is enough for this project.
CONFIG_WRAM_LENGTH = 0x15000

ifeq ($(CHIP),bl618dg)
    CONFIG_ROMAPI             =n
    CONFIG_DUALCORE_DISABLE   =y
    CONFIG_WRAM_FOR_AP_SIZE   = 0x50000
    CONFIG_RAM_FOR_AP_SIZE    = 0x50000
    CONFIG_PSRAM_FOR_AP_SIZE  = 0x400000  # 4MB PSRAM for AP core
endif
```
